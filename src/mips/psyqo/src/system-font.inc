// font is mig68000, available for free with attribution, made by Zingot
// Games, https://www.zingot.com/ & https://zingot.itch.io/fontpack

// This file has been generated by the script font-compress.lua in the
// same directory. Please go check it for details on how this works.

static const unsigned char s_systemFont[] = {
    // offsets to luts and bitstream
    0x5a, 0x87,

    // binary tree
    0x04, 0x46, 0x06, 0x3e, 0x08, 0x34, 0x0a, 0x2e, 0x0c, 0x16, 0x00, 0x0e, 0x10, 0xfb, 0x12, 0x14, 0xff, 0xfe, 0xfd,
    0xfc, 0x18, 0x2a, 0x1a, 0x22, 0x1c, 0xf6, 0x1e, 0x20, 0xfa, 0xf9, 0xf8, 0xf7, 0x24, 0x26, 0xf5, 0xf4, 0x28, 0xf1,
    0xf3, 0xf2, 0xf0, 0x2c, 0xef, 0xee, 0xed, 0x30, 0xec, 0x32, 0xeb, 0xea, 0xe9, 0x36, 0x38, 0xe4, 0xe8, 0x3a, 0x3c,
    0xe5, 0xe7, 0xe6, 0xe3, 0x40, 0xe2, 0x42, 0x44, 0xdf, 0xe1, 0xe0, 0xde, 0x48, 0xdd, 0x4a, 0x4c, 0x4e, 0xdc, 0xdb,
    0x50, 0xd4, 0x52, 0xd5, 0x54, 0xd6, 0xda, 0x56, 0xd9, 0x58, 0xd8, 0xd7,

    // lut
    0x33, 0x73, 0xdc, 0x3b, 0x67, 0x03, 0x6e, 0x6f, 0x3f, 0x56, 0x78, 0x0f, 0x37, 0x1f, 0x35, 0x08, 0x76, 0xc0, 0x1b,
    0x3e, 0x7c, 0x6b, 0x70, 0x7e, 0x1c, 0x7b, 0x77, 0x0e, 0x63, 0x18, 0x06, 0x7f, 0x38, 0x60, 0x00, 0x66, 0x30, 0x0c,
    0xc3, 0x6c, 0xde, 0xff, 0x1e, 0x36, 0x3c,

    // bitstream
    0xe9, 0x7d, 0x95, 0xab, 0x73, 0xab, 0x82, 0xfb, 0xfa, 0xdf, 0x25, 0x97, 0xfe, 0xaf, 0xea, 0xa7, 0xf7, 0x55, 0x98,
    0x5c, 0xa6, 0x2a, 0x38, 0x62, 0x88, 0x5c, 0x72, 0x89, 0xa8, 0x2a, 0x4a, 0xef, 0x8b, 0xed, 0x91, 0xa4, 0xa9, 0xf2,
    0x7b, 0x6e, 0xdf, 0xae, 0xdf, 0x24, 0x9f, 0x2d, 0xbd, 0x2f, 0x81, 0x7e, 0x24, 0xc6, 0x9d, 0x2a, 0xbf, 0xe7, 0xf6,
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    0xaa, 0x2a, 0xac, 0x50, 0x55, 0xe6, 0xab, 0xaa, 0x5b, 0x55, 0x55, 0xd5, 0xaf, 0x67, 0x55, 0xe6, 0xab, 0xaa, 0x5b,
    0x55};

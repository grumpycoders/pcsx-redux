.set push
.set noreorder
.set noat

#include <mipsregs.h>

.text

.macro M_KCALL, label, tablenum, callnum
.global \label
.type \label, @function
.ent \label
\label:
                li      t1, \tablenum
                jr      t1
                li      t0, \callnum
.end \label
.endm

.macro M_SYSCALL, label, callNum
.global \label
.type \label, @function
.ent \label
\label:
                li      a0, \callNum
                syscall 0
                jr      ra
                nop
.end \label
.endm

.macro M_BREAK, label, code
.global \label
.type \label, @function
.ent \label
\label:
                break \code
                jr      ra
                nop
.end \label
.endm

/* this will only be accurate if interrupts are disabled */
.global delay_ms
.type delay_ms, @function
.ent delay_ms
delay_ms:
                li      t0, 1665
_delay_ms_l2:
                bnez    t0, _delay_ms_l2
                addiu   t0, -1
                bnez    a0, delay_ms
                addiu   a0, -1
                jr      ra
                nop
.end delay_ms

M_KCALL open, 0xA0, 0x0000
M_KCALL lseek, 0xA0, 0x0001
M_KCALL read, 0xA0, 0x0002
M_KCALL write, 0xA0, 0x0003
M_KCALL close, 0xA0, 0x0004
M_KCALL ioctl, 0xA0, 0x0005
M_KCALL exit, 0xA0, 0x0006
M_KCALL sys_b0_39, 0xA0, 0x0007
M_KCALL getc, 0xA0, 0x0008
M_KCALL putc, 0xA0, 0x0009
M_KCALL todigit, 0xA0, 0x000a
M_KCALL atof, 0xA0, 0x000b
M_KCALL strtoul, 0xA0, 0x000c
M_KCALL strtol, 0xA0, 0x000d
M_KCALL abs, 0xA0, 0x000e
M_KCALL fabs, 0xA0, 0x000f
M_KCALL atoi, 0xA0, 0x0010
M_KCALL atol, 0xA0, 0x0011
M_KCALL atob, 0xA0, 0x0012
M_KCALL setjmp, 0xA0, 0x0013
M_KCALL longjmp, 0xA0, 0x0014
M_KCALL strcat, 0xA0, 0x0015
M_KCALL strncat, 0xA0, 0x0016
M_KCALL strcmp, 0xA0, 0x0017
M_KCALL strncmp, 0xA0, 0x0018
M_KCALL strcpy, 0xA0, 0x0019
M_KCALL strncpy, 0xA0, 0x001a
M_KCALL strlen, 0xA0, 0x001b
M_KCALL index, 0xA0, 0x001c
M_KCALL rindex, 0xA0, 0x001d
M_KCALL strchr, 0xA0, 0x001e
M_KCALL strrchr, 0xA0, 0x001f
M_KCALL strpbrk, 0xA0, 0x0020
M_KCALL strspn, 0xA0, 0x0021
M_KCALL strcspn, 0xA0, 0x0022
M_KCALL strtok, 0xA0, 0x0023
M_KCALL strstr, 0xA0, 0x0024
M_KCALL toupper, 0xA0, 0x0025
M_KCALL tolower, 0xA0, 0x0026
M_KCALL bcopy, 0xA0, 0x0027
M_KCALL bzero, 0xA0, 0x0028
M_KCALL bcmp, 0xA0, 0x0029
M_KCALL memcpy, 0xA0, 0x002a
M_KCALL memset, 0xA0, 0x002b
M_KCALL memmove, 0xA0, 0x002c
M_KCALL memcmp, 0xA0, 0x002d
M_KCALL memchr, 0xA0, 0x002e
M_KCALL rand, 0xA0, 0x002f
M_KCALL srand, 0xA0, 0x0030
M_KCALL qsort, 0xA0, 0x0031
M_KCALL strtod, 0xA0, 0x0032
M_KCALL malloc, 0xA0, 0x0033
M_KCALL free, 0xA0, 0x0034
M_KCALL lsearch, 0xA0, 0x0035
M_KCALL bsearch, 0xA0, 0x0036
M_KCALL calloc, 0xA0, 0x0037
M_KCALL realloc, 0xA0, 0x0038
M_KCALL InitHeap, 0xA0, 0x0039
M_KCALL _exit_A0_58, 0xA0, 0x003a
M_KCALL getchar, 0xA0, 0x003b
M_KCALL putchar, 0xA0, 0x003c
M_KCALL gets, 0xA0, 0x003d
M_KCALL puts, 0xA0, 0x003e
M_KCALL printf, 0xA0, 0x003f
M_KCALL LoadTest, 0xA0, 0x0041
M_KCALL Load, 0xA0, 0x0042
M_KCALL Exec, 0xA0, 0x0043
M_KCALL FlushCache, 0xA0, 0x0044
M_KCALL InstallInterruptDispatch, 0xA0, 0x0045
M_KCALL GPU_dw, 0xA0, 0x0046
M_KCALL GPU_mem2vram, 0xA0, 0x0047
M_KCALL SetGPUStatus, 0xA0, 0x0048
M_KCALL GPU_cw, 0xA0, 0x0049
M_KCALL GPU_cwb, 0xA0, 0x004a
M_KCALL GPU_SendPackets, 0xA0, 0x004B
M_KCALL GPU_abort, 0xA0, 0x004C
M_KCALL GetGPUStatus, 0xA0, 0x004d
M_KCALL GPU_sync, 0xA0, 0x004e
M_KCALL LoadExec, 0xA0, 0x0051
M_KCALL GetSysSp, 0xA0, 0x0052
M_KCALL _96_init, 0xA0, 0x0054
M_KCALL _bu_init, 0xA0, 0x0055
M_KCALL _96_remove, 0xA0, 0x0056
M_KCALL dev_tty_init, 0xA0, 0x005b
M_KCALL dev_tty_open, 0xA0, 0x005c
M_KCALL dev_tty_strategy, 0xA0, 0x005D
M_KCALL dev_tty_ioctl, 0xA0, 0x005e
M_KCALL dev_cd_open, 0xA0, 0x005f
M_KCALL dev_cd_read, 0xA0, 0x0060
M_KCALL dev_cd_close, 0xA0, 0x0061
M_KCALL dev_cd_firstfile, 0xA0, 0x0062
M_KCALL dev_cd_nextfile, 0xA0, 0x0063
M_KCALL dev_cd_chdir, 0xA0, 0x0064
M_KCALL dev_card_open, 0xA0, 0x0065
M_KCALL dev_card_read, 0xA0, 0x0066
M_KCALL dev_card_write, 0xA0, 0x0067
M_KCALL dev_card_close, 0xA0, 0x0068
M_KCALL dev_card_firstfile, 0xA0, 0x0069
M_KCALL dev_card_nextfile, 0xA0, 0x006a
M_KCALL dev_card_erase, 0xA0, 0x006b
M_KCALL dev_card_undelete, 0xA0, 0x006c
M_KCALL dev_card_format, 0xA0, 0x006d
M_KCALL dev_card_rename, 0xA0, 0x006e
M_KCALL dev_card_call111, 0xA0, 0x006F
/* M_KCALL _bu_init, 0xA0, 0x0070
 M_KCALL _96_init, 0xA0, 0x0071
 M_KCALL _96_remove, 0xA0, 0x0072
*/
M_KCALL _96_CdSeekL, 0xA0, 0x0078
M_KCALL _96_CdGetStatus, 0xA0, 0x007c
M_KCALL _96_CdRead, 0xA0, 0x007e
M_KCALL _96_SetMode, 0xA0, 0x0081
M_KCALL _96_CdStop, 0xA0, 0x0085
M_KCALL _kcallA0_144, 0xA0, 0x0090
M_KCALL _kcallA0_145, 0xA0, 0x0091
M_KCALL _kcallA0_146, 0xA0, 0x0092
M_KCALL _kcallA0_147, 0xA0, 0x0093
M_KCALL _kcallA0_148, 0xA0, 0x0094
M_KCALL _kcallA0_149, 0xA0, 0x0095
M_KCALL AddCDROMDevice, 0xA0, 0x0096
M_KCALL AddMemCardDevice, 0xA0, 0x0097
M_KCALL AddDEBUGCONDevice, 0xA0, 0x0098
// aka add_nullcon_driver and AddConsoleDevice
M_KCALL AddDummyConsoleDevice, 0xA0, 0x0099
M_KCALL SetConf, 0xA0, 0x009c
M_KCALL GetConf, 0xA0, 0x009d
M_KCALL _kcallA0_158, 0xA0, 0x009E
M_KCALL SetMem, 0xA0, 0x009f
M_KCALL _boot, 0xA0, 0x00A0
M_KCALL SystemError, 0xA0, 0x00a1
M_KCALL EnqCdIntr, 0xA0, 0x00a2
M_KCALL DeqCdIntr, 0xA0, 0x00a3
M_KCALL _96_call_A0_164, 0xA0, 0x00A4
M_KCALL ReadSector, 0xA0, 0x00a5
M_KCALL IsCdOpen, 0xA0, 0x00a6
M_KCALL bufs_cb_0, 0xA0, 0x00a7
M_KCALL bufs_cb_1, 0xA0, 0x00a8
M_KCALL bufs_cb_2, 0xA0, 0x00a9
M_KCALL bufs_cb_3, 0xA0, 0x00aa
M_KCALL _card_info, 0xA0, 0x00ab
M_KCALL _card_load, 0xA0, 0x00ac
M_KCALL _card_auto, 0xA0, 0x00ad
M_KCALL bufs_cb_4, 0xA0, 0x00ae
M_KCALL _card_call175, 0xA0, 0x00AF
M_KCALL do_longjmp, 0xA0, 0x00b2
M_KCALL GetKernelInfo, 0xA0, 0x00b4
M_KCALL _SysMalloc, 0xB0, 0x0000
M_KCALL SysFree, 0xB0, 1
M_KCALL SetRCnt, 0xB0, 2
M_KCALL GetRCnt, 0xB0, 3
M_KCALL StartRCnt, 0xB0, 4
M_KCALL StopRCnt, 0xB0, 5
M_KCALL ResetRCnt, 0xB0, 6
M_KCALL DeliverEvent, 0xB0, 0x0007
M_KCALL OpenEvent, 0xB0, 0x0008
M_KCALL CloseEvent, 0xB0, 0x0009
M_KCALL WaitEvent, 0xB0, 0x000a
M_KCALL TestEvent, 0xB0, 0x000b
M_KCALL EnableEvent, 0xB0, 0x000c
M_KCALL DisableEvent, 0xB0, 0x000d
M_KCALL OpenTh, 0xB0, 0x000e
M_KCALL CloseTh, 0xB0, 0x000f
M_KCALL ChangeTh, 0xB0, 0x0010
M_KCALL InitPAD, 0xB0, 0x0012
M_KCALL StartPAD, 0xB0, 0x0013
M_KCALL StopPAD, 0xB0, 0x0014
M_KCALL PAD_init, 0xB0, 0x0015
M_KCALL PAD_dr, 0xB0, 0x0016
M_KCALL ReturnFromException, 0xB0, 0x0017
M_KCALL ResetEntryInt, 0xB0, 0x0018
M_KCALL HookEntryInt, 0xB0, 0x0019
M_KCALL UnDeliverEvent, 0xB0, 0x0020
M_KCALL _open, 0xB0, 0x0032
M_KCALL _lseek, 0xB0, 0x0033
M_KCALL _read, 0xB0, 0x0034
M_KCALL _write, 0xB0, 0x0035
M_KCALL _close, 0xB0, 0x0036
M_KCALL _ioctl, 0xB0, 0x0037
M_KCALL _exit, 0xB0, 0x0038
M_KCALL _is_a_tty, 0xB0, 0x0039
M_KCALL _getc, 0xB0, 0x003A
M_KCALL _putc, 0xB0, 0x003B
M_KCALL _getchar, 0xB0, 0x003C
M_KCALL _putchar, 0xB0, 0x003D
M_KCALL _gets, 0xB0, 0x003E
M_KCALL _puts, 0xB0, 0x003F
M_KCALL _chdir, 0xB0, 0x0040
M_KCALL _format, 0xB0, 0x0041
M_KCALL firstfile, 0xB0, 0x0042
M_KCALL nextfile, 0xB0, 0x0043
M_KCALL rename, 0xB0, 0x0044
/* alias delete */
M_KCALL remove, 0xB0, 0x0045
M_KCALL undelete, 0xB0, 0x0046
/* Alias AddDrv */
M_KCALL AddDevice, 0xB0, 0x0047
/* Alias DelDrv */
M_KCALL DelDevice, 0xB0, 0x0048
M_KCALL PrintInstalledDevices, 0xB0, 0x0049
M_KCALL InitCARD, 0xB0, 0x004a
M_KCALL StartCARD, 0xB0, 0x004b
M_KCALL StopCARD, 0xB0, 0x004c
M_KCALL _card_callB0_77, 0xB0, 0x004D
M_KCALL _card_write, 0xB0, 0x004e
M_KCALL _card_read, 0xB0, 0x004f
M_KCALL _new_card, 0xB0, 0x0050
M_KCALL Krom2RawAdd, 0xB0, 0x0051
M_KCALL _kcallB0_83, 0xB0, 0x0053
M_KCALL _get_errno, 0xB0, 0x0054
M_KCALL _get_error, 0xB0, 0x0055
M_KCALL GetC0Table, 0xB0, 0x0056
M_KCALL GetB0Table, 0xB0, 0x0057
M_KCALL _card_chan, 0xB0, 0x0058
M_KCALL iocall_B0_89, 0xB0, 0x0059
M_KCALL ChangeClearPad, 0xB0, 0x005b
M_KCALL _card_status, 0xB0, 0x005c
M_KCALL _card_wait, 0xB0, 0x005d
M_KCALL InitRCnt, 0xC0, 0x0000
M_KCALL InitException, 0xC0, 0x0001
M_KCALL SysEnqIntRP, 0xC0, 0x0002
M_KCALL SysDeqIntRP, 0xC0, 0x0003
M_KCALL get_free_event_slot, 0xC0, 0x0004
M_KCALL get_free_TCB_slot, 0xC0, 0x0005
M_KCALL ExceptionHandler, 0xC0, 0x0006
M_KCALL InstallExceptionHandlers, 0xC0, 0x0007
M_KCALL SysInitMemory, 0xC0, 0x0008
M_KCALL SysInitKMem, 0xC0, 0x0009
M_KCALL ChangeClearRCnt, 0xC0, 0x000a
/*M_KCALL SystemError, 0xC0, 0x000b*/
M_KCALL InitDefInt, 0xC0, 0x000c
M_KCALL SetIrqClearEn, 0xC0, 0xD
M_KCALL InstallDevices, 0xC0, 0x0012
M_KCALL FlushStdInOut, 0xC0, 0x0013
M_KCALL GetWord8644, 0xC0, 0x0014
M_KCALL _cdevinput, 0xC0, 0x0015
M_KCALL _cdevscan, 0xC0, 0x0016
M_KCALL _circgetc, 0xC0, 0x0017
M_KCALL _circputc, 0xC0, 0x0018
M_KCALL ioabort, 0xC0, 0x0019
M_KCALL SetWord8644, 0xC0, 0x001A
M_KCALL KernelRedirect, 0xC0, 0x001B
M_KCALL PatchAOTable, 0xC0, 0x001C

M_SYSCALL   Exception, 0
M_SYSCALL   EnterCriticalSection, 1
M_SYSCALL   ExitCriticalSection, 2

M_BREAK     PCInit, 0x0101

.global GetCOP0_STATUS
.type GetCOP0_STATUS, @function
.ent GetCOP0_STATUS
GetCOP0_STATUS:
                mfc0    v0, C0_STATUS
                nop
                jr      ra
                nop
.end GetCOP0_STATUS

.global SetCOP0_STATUS
.type SetCOP0_STATUS, @function
.ent SetCOP0_STATUS
SetCOP0_STATUS:
                mtc0    a0, C0_STATUS
                nop
                jr      ra
                nop
.end SetCOP0_STATUS

.set pop
